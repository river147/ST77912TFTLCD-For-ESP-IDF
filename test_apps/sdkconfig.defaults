## test_apps/sdkconfig.defaults
```kconfig
# Basic frequency and RTOS
CONFIG_ESP_DEFAULT_CPU_FREQ_MHZ_240=y
CONFIG_FREERTOS_HZ=1000
CONFIG_ESP_TASK_WDT_INIT=n
CONFIG_FREERTOS_TIMER_TASK_STACK_DEPTH=4096

# Disable heavy subsystems not needed for LCD tests
CONFIG_BT_ENABLED=n
CONFIG_BT_BLE_ENABLED=n
CONFIG_BT_CLASSIC_ENABLED=n
CONFIG_ESP_WIFI_ENABLED=n
CONFIG_ESP_NETIF_IP_LOST_TIMER=n
CONFIG_LWIP_ENABLED=n
CONFIG_MBEDTLS_TLS_ENABLED=n
CONFIG_MQTT_PROTOCOL_311=n
CONFIG_MQTT_SUPPORT_WEBSOCKET=n
CONFIG_ESP_HTTP_CLIENT_ENABLE_HTTPS=n
CONFIG_ESP_TLS_SERVER=n
CONFIG_ESP_HTTP_SERVER_ENABLE=n
CONFIG_ESP_HTTPS_SERVER_ENABLE=n
CONFIG_USB_ENABLED=n
CONFIG_OPENTHREAD_ENABLED=n
CONFIG_ETH_ENABLED=n

# Misc trims
CONFIG_LOG_COLORS=n
CONFIG_ESP_SYSTEM_PANIC_REBOOT=y
CONFIG_ESP_CONSOLE_UART_DEFAULT=y
```
